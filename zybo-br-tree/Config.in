## zybo-br-tree/Config.in
```kconfig
source "$BR2_EXTERNAL_ZYBO_Z7_PATH/package/crc32_example/Config.in"
source "$BR2_EXTERNAL_ZYBO_Z7_PATH/package/radioctl/Config.in"
source "$BR2_EXTERNAL_ZYBO_Z7_PATH/package/radiomon/Config.in"
```

## zybo-br-tree/configs/pynq_z1_defconfig
```kconfig
BR2_arm=y
BR2_cortex_a9=y
BR2_ARM_ENABLE_NEON=y
BR2_ARM_ENABLE_VFP=y
BR2_TOOLCHAIN_EXTERNAL=y
BR2_TARGET_GENERIC_HOSTNAME="pynq-z1"
BR2_TARGET_GENERIC_ISSUE="Welcome to the PYNQ-Z1"
BR2_ROOTFS_DEVICE_CREATION_DYNAMIC_MDEV=y
BR2_ROOTFS_MERGED_USR=y
BR2_ROOTFS_POST_IMAGE_SCRIPT="$(BR2_EXTERNAL_ZYBO_Z7_PATH)/board/common/post-image.sh"
BR2_ROOTFS_POST_SCRIPT_ARGS="pynq-z1.dtb"
BR2_TARGET_ROOTFS_EXT2=y
BR2_TARGET_ROOTFS_EXT2_4=y
BR2_TARGET_ROOTFS_EXT2_SIZE="256M"
BR2_PACKAGE_E2FSPROGS=y
BR2_PACKAGE_E2FSPROGS_FSCK=y
BR2_LINUX_KERNEL=y
BR2_LINUX_KERNEL_DEFCONFIG="multi_v7"
BR2_LINUX_KERNEL_DTS_SUPPORT=y
BR2_LINUX_KERNEL_CUSTOM_DTS_PATH="$(BR2_EXTERNAL_ZYBO_Z7_PATH)/board/pynq-z1/pynq-z1.dts"
BR2_TARGET_ROOTFS_CPIO=y
BR2_TARGET_ROOTFS_CPIO_GZIP=y
BR2_PACKAGE_BUSYBOX_CONFIG_FRAGMENT_FILES="$(BR2_EXTERNAL_ZYBO_Z7_PATH)/board/common/busybox-ntp.config"
BR2_ROOTFS_OVERLAY="$(BR2_EXTERNAL_ZYBO_Z7_PATH)/board/pynq-z1/overlay"
BR2_PACKAGE_DROPBEAR=y
BR2_PACKAGE_RADIOCTL=y
BR2_PACKAGE_RADIOMON=y
BR2_TARGET_GENERIC_ROOT_PASSWD="root"
# BR2_TARGET_ROOTFS_TAR is not set
BR2_TARGET_UBOOT=y
BR2_TARGET_UBOOT_CUSTOM_VERSION=y
BR2_TARGET_UBOOT_CUSTOM_VERSION_VALUE="2019.10"
BR2_TARGET_UBOOT_BUILD_SYSTEM_KCONFIG=y
BR2_TARGET_UBOOT_BOARD_DEFCONFIG="zynq_pynq_z1"
BR2_TARGET_UBOOT_PATCH="$(BR2_EXTERNAL_ZYBO_Z7_PATH)/board/pynq-z1/uboot-patches/0001-ARM-zynq-add-Digilent-Zynq-PYNQ-Z1.patch $(BR2_EXTERNAL_ZYBO_Z7_PATH)/board/pynq-z1/uboot-patches/0001-pynq-add-ps7_init_gpl.c.patch"
BR2_TARGET_UBOOT_NEEDS_DTC=y
BR2_TARGET_UBOOT_NEEDS_OPENSSL=y
# BR2_TARGET_UBOOT_FORMAT_BIN is not set
BR2_TARGET_UBOOT_FORMAT_IMG=y
BR2_TARGET_UBOOT_SPL=y
BR2_TARGET_UBOOT_SPL_NAME="spl/boot.bin"
BR2_PACKAGE_HOST_UBOOT_TOOLS=y
BR2_PACKAGE_HOST_UBOOT_TOOLS_FIT_SUPPORT=y
```

## zybo-br-tree/configs/zybo_z720_defconfig
```kconfig
BR2_arm=y
BR2_cortex_a9=y
BR2_ARM_ENABLE_NEON=y
BR2_ARM_ENABLE_VFP=y
BR2_TOOLCHAIN_EXTERNAL=y
BR2_TARGET_GENERIC_HOSTNAME="zybo-z720"
BR2_TARGET_GENERIC_ISSUE="Welcome to the Zybo Z7-20"
BR2_ROOTFS_DEVICE_CREATION_DYNAMIC_MDEV=y
BR2_ROOTFS_MERGED_USR=y
BR2_ROOTFS_POST_IMAGE_SCRIPT="$(BR2_EXTERNAL_ZYBO_Z7_PATH)/board/common/post-image.sh"
BR2_ROOTFS_POST_SCRIPT_ARGS="zynq-zybo-z7-radio.dtb $(BR2_EXTERNAL_ZYBO_Z7_PATH)/board/common/zybo_radio.bit"
BR2_TARGET_ROOTFS_EXT2=y
BR2_TARGET_ROOTFS_EXT2_4=y
BR2_TARGET_ROOTFS_EXT2_SIZE="256M"
BR2_PACKAGE_E2FSPROGS=y
BR2_PACKAGE_E2FSPROGS_FSCK=y
BR2_LINUX_KERNEL=y
BR2_LINUX_KERNEL_DEFCONFIG="multi_v7"
BR2_LINUX_KERNEL_DTS_SUPPORT=y
BR2_LINUX_KERNEL_CUSTOM_DTS_PATH="$(BR2_EXTERNAL_ZYBO_Z7_PATH)/board/common/zynq-zybo-z7-radio.dts"
BR2_LINUX_KERNEL_CONFIG_FRAGMENT_FILES="$(BR2_EXTERNAL_ZYBO_Z7_PATH)/board/common/linux-radio.config"
BR2_TARGET_ROOTFS_CPIO=y
BR2_TARGET_ROOTFS_CPIO_GZIP=y
BR2_PACKAGE_BUSYBOX_CONFIG_FRAGMENT_FILES="$(BR2_EXTERNAL_ZYBO_Z7_PATH)/board/common/busybox-ntp.config"
BR2_ROOTFS_OVERLAY="$(BR2_EXTERNAL_ZYBO_Z7_PATH)/board/common/overlay"
BR2_PACKAGE_DROPBEAR=y
BR2_PACKAGE_RADIOCTL=y
BR2_TARGET_GENERIC_ROOT_PASSWD="root"
# BR2_TARGET_ROOTFS_TAR is not set
BR2_TARGET_UBOOT=y
BR2_TARGET_UBOOT_CUSTOM_VERSION=y
BR2_TARGET_UBOOT_CUSTOM_VERSION_VALUE="2019.10"
BR2_TARGET_UBOOT_BUILD_SYSTEM_KCONFIG=y
BR2_TARGET_UBOOT_BOARD_DEFCONFIG="zynq_zybo_z7"
BR2_TARGET_UBOOT_NEEDS_DTC=y
BR2_TARGET_UBOOT_NEEDS_OPENSSL=y
# BR2_TARGET_UBOOT_FORMAT_BIN is not set
BR2_TARGET_UBOOT_FORMAT_IMG=y
BR2_TARGET_UBOOT_SPL=y
BR2_TARGET_UBOOT_SPL_NAME="spl/boot.bin"
BR2_PACKAGE_HOST_UBOOT_TOOLS=y
BR2_PACKAGE_HOST_UBOOT_TOOLS_FIT_SUPPORT=y
```

## zybo-br-tree/package/radioctl/Config.in
```kconfig
config BR2_PACKAGE_RADIOCTL
	bool "radioctl"
	help
	  Command line tool for the comms DSP radio register space.
	  Maps the PL register window via UIO and exposes register
	  read/write plus role/enable/transmit helpers.

	  Requires the generic-uio devicetree node and
	  uio_pdrv_genirq.of_id=generic-uio on the kernel command line.
```

## zybo-br-tree/package/radiomon/Config.in
```kconfig
config BR2_PACKAGE_RADIOMON
	bool "radiomon"
	depends on BR2_INSTALL_LIBSTDCPP
	help
	  Live terminal monitor for the comms DSP receiver. Polls the PL
	  register window and plots the lock-quality ratio (qmin/qmax)
	  as it moves, alongside the frame, error and sync counters.

	  Reads the register window only - it never maps the DMA, so it
	  is safe to leave running while the PL's state is uncertain.

	  Requires the generic-uio devicetree node and
	  uio_pdrv_genirq.of_id=generic-uio on the kernel command line.

comment "radiomon needs a toolchain w/ C++"
	depends on !BR2_INSTALL_LIBSTDCPP
```
